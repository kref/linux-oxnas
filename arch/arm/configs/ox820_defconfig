## drivers/misc/iscsitarget/Kconfig
```kconfig
#
# iscsi target driver configuration
#

config ISCSI_TARGET
	tristate "iSCSI Enterprise Target"
	default n
	select CRYPTO
	select CRYPTO_HASH
	select CRYPTO_CRC32C
	select CRYPTO_MD5
	---help---
	  Say Y here if you want to export devices to iSCSI initiators.

	  This option is the kernel part of the iET package version 1.4.20.2
	  (see http://iscsitarget.sourceforge.net/). It depends on 'CRYPTO' 
	  support being enabled, and within the cryptographic API, the CRC32C
	  and MD5 modules also being enabled.

	  To compile this driver as a module, choose M here: the
	  module will be called iscsi_trgt
```

## drivers/reset/Kconfig
```kconfig
config ARCH_HAS_RESET_CONTROLLER
	bool

menuconfig RESET_CONTROLLER
	bool "Reset Controller Support"
	default y if ARCH_HAS_RESET_CONTROLLER
	help
	  Generic Reset Controller support.

	  This framework is designed to abstract reset handling of devices
	  via GPIOs or SoC-internal reset controller modules.

	  If unsure, say no.

config RESET_CONTROLLER_OXNAS
	bool
	select RESET_CONTROLLER
```
